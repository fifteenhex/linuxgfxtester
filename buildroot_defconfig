## buildroot_defconfig
```kconfig
BR2_x86_64=y
BR2_KERNEL_HEADERS_6_1=y
BR2_BINUTILS_VERSION_2_39_X=y
BR2_GCC_VERSION_12_X=y
BR2_TOOLCHAIN_BUILDROOT_CXX=y
BR2_ENABLE_DEBUG=y
BR2_LINUX_KERNEL=y
BR2_LINUX_KERNEL_USE_CUSTOM_CONFIG=y
BR2_LINUX_KERNEL_CUSTOM_CONFIG_FILE="$(BR2_EXTERNAL_QEMU_PATH)/boards/qemu/x86-64/linux_defconfig"
BR2_PACKAGE_CHOCOLATE_DOOM=y
BR2_PACKAGE_DOOM_WAD=y
BR2_PACKAGE_SDL2_IMAGE=y
BR2_TARGET_ROOTFS_INITRAMFS=y
BR2_PACKAGE_HOST_QEMU=y
BR2_PACKAGE_HOST_QEMU_SYSTEM_MODE=y
BR2_PACKAGE_DIRECTFB2=y
BR2_PACKAGE_DIRECTFB2_DRMKMS=y
BR2_PACKAGE_DIRECTFB2_EXAMPLES=y
BR2_PACKAGE_DIRECTFB2_TOOLS=y
BR2_PACKAGE_DFBTERM=y
BR2_PACKAGE_DFB2LITE=y
BR2_PACKAGE_SDL2_DIRECTFB2=y
```
